## esp32c3/main/Kconfig.projbuild
```kconfig
menu "Cylinder Arm Configuration"
    config IS_HUB
        bool "Select if this is hub device"
        default "n"
        help
            Will choose if the device is a distributed device or the hub one
    
    menu "Hub Config"
        depends on IS_HUB
        
        config NUM_DISTRIBUTED_CONTROLLERS
            int "Number of distributed controllers"
            default 1
            range 0 20
            help
                The number of distributed controllers that the hub is communicating with
        
        config BYTES_PER_CONTROLLER
            int "Number of bytes received/sent to each distributed controller"
            default 2
            range 1 20
            help
                The number of bytes required to send setpoints and/or receive sensor data for each controller
    endmenu

    menu "Distributed Config"
        depends on !IS_HUB
        choice SENSOR_TYPE
            prompt "Choose which sensor type is used"
            default I2C_SENSOR

        config I2C_SENSOR
            bool "I2C Sensor (AS5600)"

        config PWM_SENSOR
            bool "PWM Sensor (Pololu Distance Sensor)"

        endchoice
    endmenu
    
    config ESPNOW_CHANNEL
        int "ESPNOW Channel"
        default 1
        range 0 14
        help
            The channel on which you send and receive ESPNOW data

    config DEBUG
        bool "Enable debug mode"
        default "y"
        help
            When debug is enabled, more information will be available on serial monitor
endmenu
```
